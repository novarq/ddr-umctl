// SPDX-License-Identifier: (GPL-2.0+ OR MIT)
/*
 * Copyright (C) 2022 Microchip Technology Inc. and its subsidiaries.
 *
 */

&ddr {
	microchip,mem-name = "lan969x_tactical_1000_2gb 2026-04-29-17:23:29 dbae3b1-dirty";
	microchip,mem-speed = <2400>;
	microchip,mem-size = <0x80000000>;
	microchip,mem-bus-width = <16>;

	microchip,main-reg = <
		0x00001091	/* crcparctl1 */
		0x00000001	/* dbictl */
		0x00000040	/* dfimisc */
		0x0391820f	/* dfitmg0 */
		0x00040201	/* dfitmg1 */
		0x40400003	/* dfiupd0 */
		0x004000ff	/* dfiupd1 */
		0x003f7f40	/* ecccfg0 */
		0x00020248	/* init0 */
		0x00e80000	/* init1 */
		0x0c340101	/* init3 */
		0x10180200	/* init4 */
		0x00110000	/* init5 */
		0x00000402	/* init6 */
		0x00000c19	/* init7 */
		0x81040010	/* mstr */
		0x00000000	/* pccfg */
		0x00000000	/* pwrctl */
		0x00210020	/* rfshctl0 */
		0x00000000	/* rfshctl3 */
	>;

	microchip,timing-reg = <
		0x18131414	/* dramtmg0 */
		0x0007051b	/* dramtmg1 */
		0x1a000010	/* dramtmg12 */
		0x090b0512	/* dramtmg2 */
		0x0000400c	/* dramtmg3 */
		0x08040408	/* dramtmg4 */
		0x07070404	/* dramtmg5 */
		0x07060c0b	/* dramtmg8 */
		0x0002040f	/* dramtmg9 */
		0x07000610	/* odtcfg */
		0x0049014b	/* rfshtmg */
	>;

	microchip,mapping-reg = <
		0x0000001f	/* addrmap0 */
		0x003f0909	/* addrmap1 */
		0x00000700	/* addrmap2 */
		0x00000000	/* addrmap3 */
		0x00001f1f	/* addrmap4 */
		0x07070707	/* addrmap5 */
		0x07070707	/* addrmap6 */
		0x00000f07	/* addrmap7 */
		0x00003f01	/* addrmap8 */
	>;

	microchip,phy-reg = <
		0x0000040c	/* dcr */
		0x0064401b	/* dsgcr */
		0x8000b0cf	/* dtcr0 */
		0x00010a37	/* dtcr1 */
		0x00c01884	/* dxccr */
		0x000010ba	/* pgcr2 */
		0x00000000	/* schcr1 */
		0x00079900	/* zq0pr */
		0x10077900	/* zq1pr */
		0x00000000	/* zq2pr */
		0x00058f00	/* zqcr */
	>;

	microchip,phy_timing-reg = <
		0x0827100a	/* dtpr0 */
		0x28250018	/* dtpr1 */
		0x000702a1	/* dtpr2 */
		0x03000101	/* dtpr3 */
		0x02950808	/* dtpr4 */
		0x00361009	/* dtpr5 */
		0x4ae25710	/* ptr0 */
		0x74f4950e	/* ptr1 */
		0x00083def	/* ptr2 */
		0x2a192000	/* ptr3 */
		0x1003a000	/* ptr4 */
	>;

};
